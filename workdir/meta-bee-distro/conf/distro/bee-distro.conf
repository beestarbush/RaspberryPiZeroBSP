## workdir/meta-bee-distro/conf/distro/bee-distro.conf
```bitbake
require conf/distro/poky.conf

DISTRO = "bee"
DISTRO_NAME = "bee distribution"
DISTRO_VERSION = "1.0"
DISTRO_CODENAME = "bee"

## Enable wifi
# DISTRO_FEATURES:append = " wifi"
DISTRO_FEATURES:append = " opengl"
DISTRO_FEATURES:append = " egl"
DISTRO_FEATURES:append = " glesv2"

DISTRO_FEATURES:remove = " x11 wayland ptest"

MACHINE = "raspberrypi0-wifi"

## Enable systemd
# use systemd as init manager
DISTRO_FEATURES:append = " systemd"
VIRTUAL-RUNTIME_init_manager = "systemd"
# prevent the SysVinit distribution feature from being automatically enabled
DISTRO_FEATURES_BACKFILL_CONSIDERED = "sysvinit"
# remove initscripts from the image altogether
VIRTUAL-RUNTIME_initscripts = ""
```

## workdir/meta-bee-distro/conf/layer.conf
```bitbake
# We have a conf and classes directory, add to BBPATH
BBPATH .= ":${LAYERDIR}"

# We have recipes-* directories, add to BBFILES
BBFILES += "${LAYERDIR}/recipes-*/*/*.bb \
            ${LAYERDIR}/recipes-*/*/*.bbappend"

BBFILE_COLLECTIONS += "meta-bee-distro"
BBFILE_PATTERN_meta-bee-distro = "^${LAYERDIR}/"
BBFILE_PRIORITY_meta-bee-distro = "6"

LAYERDEPENDS_meta-bee-distro = "core"
LAYERSERIES_COMPAT_meta-bee-distro = "scarthgap"
```
